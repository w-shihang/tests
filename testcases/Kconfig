## testcases/Kconfig
```kconfig
#
# For a description of the syntax of this configuration file,
# see the file kconfig-language.txt in the NuttX tools repository.
#

config TESTS_TESTCASES
	tristate "auto test module"
	default n
	---help---
		Enable support for the fs test

config TESTING_TESTCASES_PRIORITY
	int "Task priority"
	default 100
	depends on TESTS_TESTCASES

config TESTING_TESTCASES_STACKSIZE
	int "Stack size"
	default 4096
	depends on TESTS_TESTCASES

config SYSLOG_TEST
	bool "enable syslog test"
	default n
	depends on TESTS_TESTCASES

config MM_TEST
	bool "enable mm test"
	default n
	depends on TESTS_TESTCASES

config KVDB_TEST
	bool "enable kvdb test"
	default n
	depends on TESTS_TESTCASES

if KVDB_TEST
	config KVDB_TEST_API
		bool "enable kvdb_api test"
		default n
		depends on KVDB_TEST

	config KVDB_TEST_FUNCTION
		bool "enable kvdb_function test"
		default n
		depends on KVDB_TEST

	config KVDB_TEST_EXCEPTION
		bool "enable kvdb_exception test"
		default n
		depends on KVDB_TEST

	config KVDB_TEST_STRESS
		bool "enable kvdb_stress test"
		default n
		depends on KVDB_TEST

	config KVDB_TEST_STABILITY
		bool "enable kvdb_stability test"
		default n
		depends on KVDB_TEST

	config KVDB_TEST_MONITOR
		bool "enable kvdb_monitor test"
		default n
		depends on KVDB_TEST

endif # KVDB_TEST

config FS_TEST
	bool "enable fs test"
	default n
	depends on TESTS_TESTCASES

config FS_TEST_API
	bool "enable fs_api test"
	default n
	depends on FS_TEST

config FS_TEST_FUNCTION
	bool "enable fs_function test"
	default n
	depends on FS_TEST

config FS_TEST_STABILITY
	bool "enable fs_stability test"
	default n
	depends on FS_TEST

config FS_TEST_STRESS
	bool "enable fs_stress test"
	default n
	depends on FS_TEST

config FS_TEST_POWEROFF
	bool "enable fs_poweroff test"
	default n
	depends on FS_TEST

config FS_TEST_EDONLY
	bool "enable read only fs test"
	default n
	depends on FS_TEST

config SOCKET_RPMSG_TEST
	bool "enable socket rpmsg test"
	default n
	depends on TESTS_TESTCASES
	select NET_RPMSG

config RPMSGDEV_TEST
	bool "enable rpmsgdev test"
	default n
	depends on TESTS_TESTCASES

config RPMSGBLK_TEST
	bool "enable rpmsgblk test"
	default n
	depends on TESTS_TESTCASES

config RPTUNRESET_TEST
	bool "enable rptun reset test"
	default n
	depends on TESTS_TESTCASES

config UORB_CASE_TEST
	bool "enable uorb case test"
	default n
	depends on TESTS_TESTCASES

if UORB_CASE_TEST
	config UORB_ADVERTISE_DEMO
		bool "enable uorb advertise demo"
		default n

	config UORB_TEST_DEMO
		bool "enable uorb test demo"
		default n
	config UORB_RPMSG_TEST
		bool "enable uorb rpmsg test"
		default n
	config UORB_DOWNSAMPLING_TEST
		bool "enable uorb downsampling test"
		default n
endif

config SCHED_TEST
	bool "enbale schedule test"
	default n
	depends on TESTS_TESTCASES

config SOCKET_PERFORMANCE_TEST
	bool "enable socket performance test"
	default n
	depends on TESTS_TESTCASES

config FLASH_RW_TEST
	bool "enable flash rw test"
	default n
	depends on TESTS_TESTCASES

config MEDIAS_TEST
	bool "enable media test"
	default n
	depends on TESTS_TESTCASES

config MEDIA_GRAPH_TEST
	bool "enable media graph test"
	default n
	depends on MEDIAS_TEST

config MEDIA_CLIENT_TEST
	bool "enable media rpc client test"
	default n
	depends on MEDIAS_TEST

config MEDIA_SERVER_TEST
	bool "enable media rpc server test"
	default n
	depends on MEDIAS_TEST

config MEDIA_FOCUS_TEST
	bool "enable media focus test"
	default n
	depends on MEDIAS_TEST
	depends on MEDIA_FOCUS

config MEDIA_STABILITY_TEST
	bool "enable media stab test"
	default n
	depends on MEDIAS_TEST

config MEDIATEST_TOOL
	bool "enable mediatest tool"
	default n
	depends on MEDIAS_TEST

config MEDIATEST_PLAYER
	bool "enable media player"
	default n
	depends on MEDIAS_TEST

config TASK_TRACE_TEST
	bool "enable task trace test"
        default n
	depends on TESTS_TESTCASES

config SECURE_TEST
	bool "enable secure test"
	default n
	depends on TESTS_TESTCASES

if SECURE_TEST
	config CA_TEST
		bool "enable ca test"
		default n

	config KEYSTORE_TEST
		bool "enable keystore test"
		default n
endif

config CPUFREQ_TEST
	bool "enable cpufreq test"
	default n
	depends on TESTS_TESTCASES

config REGULATOR_TEST
	bool "enable regulator test"
	default n
	depends on TESTS_TESTCASES

config NETWORK_TEST
	bool "enable network test"
	default n
	depends on TESTS_TESTCASES

if NETWORK_TEST
	config DHCPC_TEST
		bool "enable dhcpc test"
		default n
	if DHCPC_TEST
		config TESTING_TIME
			int "testing time"
			default 60
	endif

	config SOCKET_STAB_TEST
		bool "enable socket stab test"
		default n

	config LOCAL_SOCKET
		bool "enable local socket test"
		default n

	config NETWORK_STABILITY_TEST
		bool "enable stability test"
		default n
endif

config MINSYS_APPLET_TEST
	bool "enbale minsys applet test"
	default n
	depends on TESTS_TESTCASES

config SPI_SLAVE_TEST
	bool "enbale spi slave test"
	default n
	depends on TESTS_TESTCASES

config SMP_TEST
	bool "enbale smp test"
	default n
	depends on TESTS_TESTCASES

config HTTP_TEST
	bool "enbale http test"
	default n
	depends on TESTS_TESTCASES
    select LIB_CURL

config TESTCASE_KASAN_TEST
	bool "enbale kasan test"
	default n
	depends on TESTS_TESTCASES

config TEST_REPEAT
	bool "enbale repeat tool"
	default n
	depends on TESTS_TESTCASES

config BINDER_AIDL_TEST
	bool "enable binder aidl test"
	default n
	depends on TESTS_TESTCASES

config FDCHECK_TEST
	bool "enable fdcheck test"
	default n
	depends on TESTS_TESTCASES

config VIBRATOR_TEST
	bool "enable vibrator test"
	default n
	depends on TESTS_TESTCASES

source "$APPSDIR/tests/testcases/graphics_test/Kconfig"
```

## testcases/graphics_test/Kconfig
```kconfig
#
# For a description of the syntax of this configuration file,
# see the file kconfig-language.txt in the NuttX tools repository.
#

menuconfig GRAPHICS_TEST
	bool "enable graphics test"
	default n
	depends on TESTS_TESTCASES

if GRAPHICS_TEST

config GRAPHICS_TEST_PRIORITY
	int "graphics test task priority"
	default 100

config GRAPHICS_TEST_STACKSIZE
	int "graphics test stack size"
	default 4096

config VIDEO_WIDGET_TEST
	bool "enable video widget test"
	default n
	depends on LVX_USE_VIDEO_ADAPTER

config ANIMATION_ENGINE_TEST
	bool "enable animation engine test"
	default n
	depends on ANIMATION_ENGINE && LVX_USE_ANIMENGINE_ADAPTER

endif # GRAPHICS_TEST
```
